## CMakeLists.txt
```
cmake_minimum_required(VERSION 3.20.0)
set(BOARD xiao_ble/nrf52840)
find_package(Zephyr REQUIRED HINTS $ENV{ZEPHYR_BASE})
project(anov)

target_sources(app PRIVATE
    src/main.c
)
```

## prj.conf
```kconfig
CONFIG_BT=y
CONFIG_LOG=y
CONFIG_BT_SMP=y
CONFIG_BT_PERIPHERAL=y
CONFIG_BT_DIS=y
CONFIG_BT_DIS_PNP=n
CONFIG_BT_BAS=y
CONFIG_BT_DEVICE_NAME="V"
CONFIG_BT_DEVICE_APPEARANCE=384

CONFIG_PWM=y
CONFIG_PWM_NRFX=y

CONFIG_LOG=y
```

## boards/xiao_ble.overlay
```dts
/ {
    // this file informs Zephyr that a servo is connected to the board via PWM on
    // pwm0 (channel 1) with a 20 ms period, and it specifies the pulse width
    // range (700 µs to 2500 µs) that corresponds to the servo’s full range of motion.
    servo: servo {
        compatible = "pwm-servo";
        pwms = <&pwm0 0 PWM_MSEC(20) PWM_POLARITY_INVERTED>;
        min-pulse = <PWM_USEC(700)>;
        max-pulse = <PWM_USEC(2500)>;
    };
};

&pwm0 {
    status = "okay";
};
```

## src/main.c
```c
#include <zephyr/kernel.h>
#include <zephyr/bluetooth/bluetooth.h>
#include <zephyr/bluetooth/uuid.h>
#include <zephyr/bluetooth/gatt.h>
#include <zephyr/bluetooth/hci.h>
#include <zephyr/logging/log.h>

LOG_MODULE_REGISTER(main);

// Custom service UUID
#define BT_UUID_CUSTOM_SERVICE_VAL \
	BT_UUID_128_ENCODE(0x12345678, 0x1234, 0x5678, 0x1234, 0x56789abcdef0)

static struct bt_uuid_128 custom_service_uuid = BT_UUID_INIT_128(
	BT_UUID_CUSTOM_SERVICE_VAL);

// Characteristic UUID
#define BT_UUID_CUSTOM_CHAR_VAL \
	BT_UUID_128_ENCODE(0x12345678, 0x4321, 0x8765, 0x4321, 0x56789abcdef0)

static struct bt_uuid_128 custom_char_uuid = BT_UUID_INIT_128(
	BT_UUID_CUSTOM_CHAR_VAL);

static uint8_t response_data[] = {'O', 'K', '!', '\n'};

static ssize_t ble_write_cb(struct bt_conn *conn,
			    const struct bt_gatt_attr *attr,
			    const void *buf,
			    uint16_t len,
			    uint16_t offset,
			    uint8_t flags)
{
	LOG_INF("Received data: %s", (const char *)buf);
	
	// Send response
	bt_gatt_notify(conn, attr, response_data, sizeof(response_data));
	return len;
}

BT_GATT_SERVICE_DEFINE(custom_service,
	BT_GATT_PRIMARY_SERVICE(&custom_service_uuid),
	BT_GATT_CHARACTERISTIC(&custom_char_uuid.uuid,
			       BT_GATT_CHRC_WRITE | BT_GATT_CHRC_NOTIFY,
			       BT_GATT_PERM_WRITE,
			       NULL, ble_write_cb, NULL),
	BT_GATT_CCC(NULL, BT_GATT_PERM_READ | BT_GATT_PERM_WRITE),
);

static struct bt_conn *current_conn;

static void connected(struct bt_conn *conn, uint8_t err)
{
	if (err) {
		LOG_ERR("Connection failed (err %u)", err);
		return;
	}

	current_conn = conn;
	LOG_INF("Connected");
}

static void disconnected(struct bt_conn *conn, uint8_t reason)
{
	LOG_INF("Disconnected (reason %u)", reason);
	current_conn = NULL;
}

BT_CONN_CB_DEFINE(conn_callbacks) = {
	.connected = connected,
	.disconnected = disconnected,
};

static void bt_ready(int err)
{
	if (err) {
		LOG_ERR("Bluetooth init failed (err %d)", err);
		return;
	}

	LOG_INF("Bluetooth initialized");
	
	err = bt_le_adv_start(BT_LE_ADV_CONN_NAME, NULL, 0, NULL, 0);
	if (err) {
		LOG_ERR("Advertising failed to start (err %d)", err);
		return;
	}
	
	LOG_INF("Advertising successfully started");
}

int main(void)
{
	int err;

	err = bt_enable(bt_ready);
	if (err) {
		LOG_ERR("Bluetooth init failed (err %d)", err);
		return 0;
	}

	while (1) {
		k_sleep(K_SECONDS(1));
	}
}
```

## src/ble.c
```c
#include <zephyr/kernel.h>
#include <zephyr/bluetooth/bluetooth.h>
#include <zephyr/bluetooth/uuid.h>
#include <zephyr/bluetooth/gatt.h>
#include <zephyr/logging/log.h>
#include "hw.h"
#include "ble.h"

LOG_MODULE_REGISTER(ble, LOG_LEVEL_DBG);

/* Callbacks de conexión Bluetooth */
static void on_connected(struct bt_conn *conn, uint8_t err)
{
    if (err) {
        LOG_ERR("Conexión fallida (error %d)", err);
        return;
    }

    char addr[BT_ADDR_LE_STR_LEN];
    bt_addr_le_to_str(bt_conn_get_dst(conn), addr, sizeof(addr));

    LOG_INF("Dispositivo conectado: %s", addr);
}

static void on_disconnected(struct bt_conn *conn, uint8_t reason)
{
    char addr[BT_ADDR_LE_STR_LEN];
    bt_addr_le_to_str(bt_conn_get_dst(conn), addr, sizeof(addr));

    LOG_INF("Dispositivo desconectado: %s (razón: 0x%02x)", addr, reason);
}

static struct bt_conn_cb conn_callbacks = {
    .connected = on_connected,    // Se ejecuta al conectar
    .disconnected = on_disconnected,  // Opcional: para detectar desconexiones
};

/* Custom 128-bit UUIDs */
#define VIBRATOR_SERVICE_UUID_VAL \
    BT_UUID_128_ENCODE(0x771a69d3, 0xc9fc, 0x4674, 0x9bce, 0xca5c48f5ba55)

#define VIBRATOR_COMMAND_UUID_VAL \
    BT_UUID_128_ENCODE(0x73d978f7, 0x7dda, 0x4ef2, 0x8cb8, 0xc5e7ae10cc2a)

static struct bt_uuid_128 vibrator_service_uuid = BT_UUID_INIT_128(VIBRATOR_SERVICE_UUID_VAL);
static struct bt_uuid_128 vibrator_command_uuid = BT_UUID_INIT_128(VIBRATOR_COMMAND_UUID_VAL);

/* Command buffer */
#define MAX_CMD_LEN 64
static char vibrator_cmd[MAX_CMD_LEN + 1];

static ssize_t write_vibrator_cmd(struct bt_conn *conn,
                                  const struct bt_gatt_attr *attr,
                                  const void *buf, uint16_t len,
                                  uint16_t offset, uint8_t flags)
{
    if (offset != 0 || len == 0 || len > MAX_CMD_LEN) {
        return BT_GATT_ERR(BT_ATT_ERR_INVALID_OFFSET);
    }

    memset(vibrator_cmd, 0, sizeof(vibrator_cmd));
    memcpy(vibrator_cmd, buf, len);
    vibrator_control(vibrator_cmd);

    return len;
}

BT_GATT_SERVICE_DEFINE(vibrator_service,
    BT_GATT_PRIMARY_SERVICE(&vibrator_service_uuid),
    BT_GATT_CHARACTERISTIC(&vibrator_command_uuid.uuid,
                           BT_GATT_CHRC_WRITE_WITHOUT_RESP,
                           BT_GATT_PERM_WRITE,
                           NULL, write_vibrator_cmd, NULL),
);

static const struct bt_data ad[] = {
    BT_DATA_BYTES(BT_DATA_FLAGS, (BT_LE_AD_GENERAL | BT_LE_AD_NO_BREDR)),
    BT_DATA_BYTES(BT_DATA_UUID128_ALL, VIBRATOR_SERVICE_UUID_VAL),
};

static const struct bt_data sd[] = {
    BT_DATA(BT_DATA_NAME_COMPLETE, CONFIG_BT_DEVICE_NAME, sizeof(CONFIG_BT_DEVICE_NAME) - 1),
};

static void bt_ready(int err)
{
    if (err) {
        LOG_ERR("Bluetooth init failed: %d", err);
        return;
    }

    bt_le_adv_start(BT_LE_ADV_CONN, ad, ARRAY_SIZE(ad), sd, ARRAY_SIZE(sd));
    LOG_INF("Advertising started");
}

void vibrator_ble_init(void)
{
    // callback de conexión
    bt_conn_cb_register(&conn_callbacks);

    // Inicializar Bluetooth
    int err = bt_enable(bt_ready);
    if (err) {
        LOG_ERR("Bluetooth enable failed: %d", err);
    }
}
```

## src/hw.c
```c
#include <zephyr/kernel.h>
#include <zephyr/logging/log.h>
#include <zephyr/device.h>
#include <zephyr/drivers/pwm.h>
#include "hw.h"

static const struct pwm_dt_spec servo = PWM_DT_SPEC_GET(DT_NODELABEL(servo));
static const uint32_t min_pulse = DT_PROP(DT_NODELABEL(servo), min_pulse);
static const uint32_t max_pulse = DT_PROP(DT_NODELABEL(servo), max_pulse);

LOG_MODULE_REGISTER(hw, LOG_LEVEL_DBG);

void vibrator_init(void)
{
    if (!pwm_is_ready_dt(&servo)) {
        LOG_ERR("PWM device %s not ready", servo.dev->name);
        return;
    }

    // Initialize with 0% duty cycle (off)
    pwm_set_pulse_dt(&servo, 0);
    LOG_INF("PWM initialized (range: %u-%u μs)", min_pulse, max_pulse);
}

// The current list of commands is as follows:

// D0 - Identify device & firmware version
// D1 - Identify TCode version
// D2 - List available axes and associated user range preferences
// DSTOP - Stop device

#define DEVICE_VERSION "1.0.0"
#define TCODE_VERSION "0.3"
void handle_device_cmd(const char *cmd)
{
    switch (cmd[1])
    {
    case '0':
        LOG_INF("Device: %s, Firmware: %s", CONFIG_BT_DEVICE_NAME, DEVICE_VERSION);
        break;
    case '1':
        LOG_INF("TCode version: %s", TCODE_VERSION);
        break;
    case '2':
        LOG_INF("Available axes: None");
        LOG_INF("User range preferences: 0-100");
        break;
    default:
        //DSTOP
        if (strcmp(cmd, "DSTOP") == 0)
        {
            LOG_INF("Stopping device");
            pwm_set_pulse_dt(&servo, 0);
        }
        else
        {
            LOG_WRN("Unknown device command: %s", cmd);
        } 

        break;
    }
}

#define VIBRATION_CHANNEL '0'
#define BASE_CMD_LEN 2
void handle_vibration_cmd(const char *cmd, int len)
{

    //V + CHANNEL + digits
   if (strlen(cmd) <= BASE_CMD_LEN)
    {
        LOG_ERR("Invalid vibration command: %s", cmd);
        return;
    }
    if (cmd[1] != VIBRATION_CHANNEL)
    {
        LOG_ERR("Invalid vibration channel (we only have 0): %c", cmd[1]);
        return;
    }

    // Extract vibration intensity
    const char *mag_str = cmd + BASE_CMD_LEN;
    size_t mag_len = len - BASE_CMD_LEN;
    float magnitude = 0;
    int divisor = 1;
    //Magnitude is 0.DIGITS
    for (size_t i = 0; i < mag_len; i++)
    {
        if (mag_str[i] < '0' || mag_str[i] > '9')
        {
            LOG_INF("Invalid vibration intensity: %s", cmd);
            return;
        }
        magnitude = magnitude * 10 + (mag_str[i] - '0');
        divisor *= 10;
    }
    magnitude /= divisor;
    //Magnitude is now a float between 0 and 1
    // Set PWM duty cycle based on magnitude

    uint32_t pulse = min_pulse + (max_pulse - min_pulse) * magnitude;

    LOG_INF("Pulse: %u", pulse);
    LOG_INF("Min pulse: %u,  Max pulse: %u", min_pulse, max_pulse);
    pwm_set_pulse_dt(&servo, pulse);
    LOG_INF("Vibration channel %c set to %.2f%% (pulse: %u μs)", cmd[1], magnitude, pulse);

}


void vibrator_control(const char *cmd)
{
    int len = strlen(cmd);
    LOG_INF("Received command: %s", cmd);
    LOG_INF("with length: %d", len);
    LOG_INF("last char: %c", cmd[len - 1]);

    if (cmd == NULL || len == 0) {
                LOG_ERR("Received empty command: %s", cmd);
        return;
    }

    switch (cmd[0]) {
    case 'D':
        handle_device_cmd(cmd);
        break;
    case 'V':
        handle_vibration_cmd(cmd, len);
        break;
    default:
        break;
    }
}
```

## src/hw.h
```c
#ifndef VIBRATOR_HW_H
#define VIBRATOR_HW_H

#ifdef __cplusplus
extern "C" {
#endif

void vibrator_init(void);
void vibrator_control(const char *cmd);

#ifdef __cplusplus
}
#endif

#endif /* VIBRATOR_HW_H */
```
